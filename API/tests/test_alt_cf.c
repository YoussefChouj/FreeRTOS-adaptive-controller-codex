/*
 * Host unit tests U1-U13 for the Z altitude / climb-rate complementary filter (z-vz-cf).
 *
 * Build+run command:
 *   gcc -std=c99 -Wall -Wextra -Werror -Wdeclaration-after-statement -Wvla -ITASK API/tests/test_alt_cf.c -lm -o test_alt_cf && ./test_alt_cf
 */
#include <stdio.h>
#include <stdint.h>
#include <string.h>
#include <math.h>

typedef uint8_t  u8;
typedef uint16_t u16;
typedef uint32_t u32;
typedef int8_t   s8;
typedef int16_t  s16;
typedef int32_t  s32;

#ifndef STAB_DT_S
#define STAB_DT_S 0.005f
#endif
#ifndef M_PER_CM
#define M_PER_CM 0.01f
#endif
#ifndef CM_PER_M
#define CM_PER_M 100.0f
#endif
#ifndef DEG2RAD
#define DEG2RAD 0.01745329251994329577f
#endif

/* Mock optical-flow / ToF sensor struct matching API/Ano_OF.h */
typedef struct {
    u8    of_update_cnt;
    u8    alt_update_cnt;
    u32   of_alt_cm;
    float of2_raw_h;
    float of2_h;
    float of2_last_h;
    float of2_h_f2_v;
    float of2_h_v;
    float of2_last_h_v;
} _ano_of_st;

_ano_of_st ano_of;

/* Mock IMU attitude & body acceleration globals */
typedef struct {
    float Pitch;
    float Roll;
    float Yaw;
} MockImuData_t;

MockImuData_t IMU_Data;

typedef struct {
    float pit;
    float rol;
    float yaw;
} MockImuLower_t;

MockImuLower_t imu_data;

float Cos_roll_01;
float Cos_pitch_01;

float Lin_Acc_X_body;
float Lin_Acc_Y_body;
float Lin_Acc_Z_body;

float Gravity_Body_X;
float Gravity_Body_Y;
float Gravity_Body_Z;

/* Mock Z cascade controller feedback struct */
typedef struct {
    float Des;
    float FB;
    float U;
    float SumE;
    float Ui;
} MockPid_t;

typedef struct {
    MockPid_t Z_posPID;
    MockPid_t Z_ratePID;
} MockCtrler_t;

MockCtrler_t Ctrler;

/* Mock arm state (0 = disarmed, 1 = armed) */
u8 Flight_Control_Lock;

#define ALT_CF_HOST_TEST 1
#define ALT_IS_ARMED() ((uint8_t)(Flight_Control_Lock ? 1U : 0U))
#include "../TASK/StabilizerTask.h"
#include "../TASK/StabilizerTask.c"


/* Frozen pre-change CF implementation (main 21033c55), golden oracle for U10.
 * Only identifier aliases isolate its state; function bodies below are unchanged. */
static _ano_of_st legacy_ano_of;
static MockCtrler_t legacy_Ctrler;
#define ano_of legacy_ano_of
#define Ctrler legacy_Ctrler
#define s_alt_valid_tick legacy_s_alt_valid_tick
#define s_alt_reject_cnt legacy_s_alt_reject_cnt
#define s_alt_hist legacy_s_alt_hist
#define s_alt_hist_n legacy_s_alt_hist_n
#define s_alt_cnt_prev legacy_s_alt_cnt_prev
#define s_alt_cf_inited legacy_s_alt_cf_inited
#define s_alt_vz_mode_prev legacy_s_alt_vz_mode_prev
#define s_alt_armed_prev legacy_s_alt_armed_prev
#define s_alt_cf_gains legacy_s_alt_cf_gains
#define g_alt_vz_mode legacy_g_alt_vz_mode
#define alt_cf legacy_alt_cf
#define Alt_CfReset legacy_Alt_CfReset
#define Alt_UpdateFB legacy_Alt_UpdateFB
#define Alt_TestResetAll legacy_Alt_TestResetAll
/* P0 Finding 2 (docs/p0-verdicts.md): per-tick ToF validity flag. 1 = this tick's
 * sample passed the band+jump gates in Update_Data. While 0 (out of range, e.g.
 * above the 5 m band ceiling or a 0xFFFF no-reading) the Z loops hold their last
 * valid FB and their integrators are frozen in Compute_Motor. */
static uint8_t  s_alt_valid_tick   = 0U;
static uint16_t s_alt_reject_cnt   = 0U;
static uint16_t s_alt_hist[3]      = {0U, 0U, 0U};
static uint8_t  s_alt_hist_n       = 0U;
static uint8_t  s_alt_cnt_prev     = 0U;
static uint8_t  s_alt_cf_inited    = 0U;
static uint8_t  s_alt_vz_mode_prev = ALT_VZ_MODE_DEFAULT;
static uint8_t  s_alt_armed_prev   = 0U;

/* Altitude complementary filter, one row per gain set; runtime state starts at 0.
   @k1      -        [0, 1]     height correction per ToF sample
   @k2      1/s      [0, 50]    climb-rate correction per ToF sample, per m of error
   @k3      1/s^2    [0, 5]     accel-bias correction per ToF sample (0 = off)
   @AccMax  m/s^2    [0, 30]    clamp on world-up linear accel */
#define ALT_CF_ROW(k1, k2, k3, AccMax) \
    { k1, k2, k3, AccMax }

static const AltCfGains s_alt_cf_gains[] = {
/*             k1     k2     k3     AccMax    set */
    ALT_CF_ROW(0.21f, 0.45f, 0.1f,  20.0f)  /* nominal  PROPOSED, S1 closed-loop sim */
};

/* Change history (newest first)
 * nominal
 *   2026-10-26 k1=0.21, k2=0.45, k3=0.1, AccMax=20.0: PROPOSED from S1 closed-loop sim (wn=3 rad/s, zeta=0.7 at Ts=0.05 s; poles |z|=0.894, 0.894, 0.988; dU p99 19.9x lower than FD)
 */

volatile uint8_t g_alt_vz_mode = ALT_VZ_MODE_DEFAULT;
AltCfState_t     alt_cf;

void Alt_CfReset(float h_init, uint8_t zero_bias)
{
	alt_cf.h = h_init;
	alt_cf.vz = 0.0f;
	alt_cf.e = 0.0f;
	alt_cf.a_up = 0.0f;
	if (zero_bias) {
		alt_cf.b_az = 0.0f;
		alt_cf.n_corr = 0U;
	}
	s_alt_cf_inited = (h_init > 0.0f) ? 1U : 0U;
	s_alt_vz_mode_prev = g_alt_vz_mode;
}

/* Altitude sanity gate (of_alt_cm is cm, u32; clamped to u16 below). Three layers (ADR-0011 Z-gate),
 * mirroring PX4/DJI altitude filtering:
 *   1. median-of-3 on the raw sample — a lone spike (in-band or the 0xFFFF
 *      no-reading) is never the median of three, so it is dropped before the
 *      band/jump gates ever see it.
 *   2. band gate — 5..500 cm (the 500 upper bound rejects 65535 no-reading;
 *      the 5 cm floor rejects sub-band 1 cm dropouts).
 *   3. rate-aware per-tick jump gate — baseline 0.05 m/tick (=10 m/s, still
 *      ~10x this drone's ~1 m/s climb), widened by the commanded vertical rate
 *      so legit fast ascents are not clipped: gate = 0.05 + 0.15*|Z_ratePID.Des|,
 *      capped at 0.20 m/tick. The 20-reject (100 ms) force-resync escape is kept
 *      so a genuine sustained level change is not locked out.
 * Then the Z FB: Z_posPID.FB = height (m), Z_ratePID.FB = low-passed climb rate (m/s), both held
 * on a rejected tick (s_alt_valid_tick = 0, P0 Finding 2). */
void Alt_UpdateFB(void)
{
	uint8_t cnt_changed;
	uint8_t sample_accepted = 0U;
	uint8_t resynced = 0U;
	uint8_t armed;
	float a_up;
	const AltCfGains *g = &s_alt_cf_gains[0];

	cnt_changed = (uint8_t)(ano_of.alt_update_cnt != s_alt_cnt_prev);
	s_alt_cnt_prev = ano_of.alt_update_cnt;

	{
		uint16_t a0, a1, a2, alt_med;

		/* Layer 1: median-of-3. */
		s_alt_hist[2] = s_alt_hist[1];
		s_alt_hist[1] = s_alt_hist[0];
		/* of_alt_cm is u32: clamp, a bare cast aliases 65536+x to x cm */
		s_alt_hist[0] = (ano_of.of_alt_cm > 0xFFFFU) ? 0xFFFFU : (uint16_t)ano_of.of_alt_cm;
		if (s_alt_hist_n < 3U) s_alt_hist_n++;
		if (s_alt_hist_n >= 3U)
		{
			a0 = s_alt_hist[0]; a1 = s_alt_hist[1]; a2 = s_alt_hist[2];
			alt_med = (a0 > a1) ? ((a1 > a2) ? a1 : ((a0 > a2) ? a2 : a0))
			                    : ((a0 > a2) ? a0 : ((a1 > a2) ? a2 : a1));
		}
		else
		{
			alt_med = s_alt_hist[0];  /* warmup: not enough history yet */
		}

		/* Layer 2: band gate. */
		if( alt_med >= ALT_BAND_MIN_CM && alt_med <= ALT_BAND_MAX_CM )
		{
			float h_new = alt_med*M_PER_CM*Cos_roll_01*Cos_pitch_01;
			/* Layer 3: rate-aware jump gate. */
			float gate = ALT_JUMP_BASE_M + ALT_JUMP_PER_VZ * fabsf(Ctrler.Z_ratePID.Des);
			uint8_t jump_ok;
			if (gate > ALT_JUMP_MAX_M) gate = ALT_JUMP_MAX_M;
			jump_ok = (uint8_t)(fabsf(h_new - ano_of.of2_raw_h) < gate);
			if( jump_ok || s_alt_reject_cnt >= ALT_RESYNC_REJECTS )
			{
				ano_of.of2_raw_h = h_new;
				s_alt_reject_cnt = 0U;
				s_alt_valid_tick = 1U;   /* P0 Finding 2: sample accepted this tick */
				if (jump_ok) {
					if (cnt_changed) sample_accepted = 1U;
				} else {
					resynced = 1U;
				}
			}
			else
			{
				s_alt_reject_cnt++;
				s_alt_valid_tick = 0U;   /* P0 Finding 2: jump-rejected - hold */
			}
		}
		else
		{
			s_alt_valid_tick = 0U;   /* P0 Finding 2: out of band (>5 m / 0xFFFF) - hold */
		}
	}

	ano_of.of2_h =ano_of.of2_raw_h;
	if (s_alt_valid_tick) { /* P0 Finding 2: valid sample - else hold last FB */
	                        /* and never publish the fake-zero d(frozen h)/dt.  */
		ano_of.of2_h_v = (ano_of.of2_h - ano_of.of2_last_h )/(STAB_DT_S);  /* one tick, 5 ms */
		ano_of.of2_last_h = ano_of.of2_h;
		ano_of.of2_h_f2_v  = ano_of.of2_h_f2_v  *ALT_RATE_LPF_OLD +ano_of.of2_h_v *ALT_RATE_LPF_NEW;

		Ctrler.Z_posPID.FB =  ano_of.of2_h;
		Ctrler.Z_ratePID.FB = ano_of.of2_h_f2_v ;
	}

	armed = ALT_IS_ARMED();
	if (g_alt_vz_mode > ALT_VZ_MODE_CF) {
		g_alt_vz_mode = s_alt_vz_mode_prev;
	}
	if (armed && g_alt_vz_mode != s_alt_vz_mode_prev) {
		g_alt_vz_mode = s_alt_vz_mode_prev;
	} else if (!armed && g_alt_vz_mode != s_alt_vz_mode_prev) {
		if (s_alt_vz_mode_prev == ALT_VZ_MODE_FD && g_alt_vz_mode == ALT_VZ_MODE_CF) {
			Alt_CfReset(ano_of.of2_h, 0U);
		}
		s_alt_vz_mode_prev = g_alt_vz_mode;
	}
	if (armed != s_alt_armed_prev) {
		Alt_CfReset(ano_of.of2_h, 0U);
		/* 2026-10-26 smoke hover: every arm waits for a real range reading. */
		if (armed) s_alt_cf_inited = 0U;
		s_alt_armed_prev = armed;
	}

	a_up = ALT_CF_ACC_SIGN * (Lin_Acc_X_body * Gravity_Body_X
	       + Lin_Acc_Y_body * Gravity_Body_Y
	       + Lin_Acc_Z_body * Gravity_Body_Z) * MG_TO_MPS2 - alt_cf.b_az;
	if (a_up > g->AccMax) a_up = g->AccMax;
	else if (a_up < -g->AccMax) a_up = -g->AccMax;
	alt_cf.a_up = a_up;

	if (!armed) {
		/* Disarmed = on the ground: pin h to the rangefinder, no velocity, no bias update.
		 * Free integration on the pad (no valid sample) drifted h to 110 m on 2026-10-26, and the
		 * camera tracker, which projects pixels at this height, rejected every fix. */
		alt_cf.h = ano_of.of2_h;
		alt_cf.vz = 0.0f;
		alt_cf.e = 0.0f;
	} else if (!s_alt_cf_inited && sample_accepted) {
		alt_cf.h = ano_of.of2_h;
		alt_cf.vz = 0.0f;
		alt_cf.e = 0.0f;
		s_alt_cf_inited = 1U;
		alt_cf.n_corr++;
	} else if (!s_alt_cf_inited) {
		/* 2026-10-26 smoke hover: hold armed-pad height until range initialization. */
		alt_cf.h = ano_of.of2_h;
		alt_cf.vz = 0.0f;
		alt_cf.e = 0.0f;
		if (resynced) s_alt_cf_inited = 1U;
	} else {
		alt_cf.h  += alt_cf.vz * STAB_DT_S + 0.5f * alt_cf.a_up * STAB_DT_S * STAB_DT_S;
		alt_cf.vz += alt_cf.a_up * STAB_DT_S;
		if (sample_accepted) {
			alt_cf.e     = ano_of.of2_h - alt_cf.h;
			alt_cf.h    += g->k1 * alt_cf.e;
			alt_cf.vz   += g->k2 * alt_cf.e;
			alt_cf.b_az -= g->k3 * alt_cf.e;
			if (alt_cf.b_az > ALT_CF_BAZ_MAX) alt_cf.b_az = ALT_CF_BAZ_MAX;
			else if (alt_cf.b_az < -ALT_CF_BAZ_MAX) alt_cf.b_az = -ALT_CF_BAZ_MAX;
			alt_cf.n_corr++;
		} else if (resynced) {
			alt_cf.e = ano_of.of2_h - alt_cf.h;
			alt_cf.h = ano_of.of2_h;
			s_alt_cf_inited = 1U;
		}
	}

	if (g_alt_vz_mode == ALT_VZ_MODE_CF) {
		Ctrler.Z_posPID.FB  = alt_cf.h;
		Ctrler.Z_ratePID.FB = alt_cf.vz;
	}
}

#ifdef ALT_CF_HOST_TEST
void Alt_TestResetAll(void)
{
	int i;
	ano_of.of_alt_cm = 0U;
	ano_of.alt_update_cnt = 0U;
	ano_of.of2_raw_h = 0.0f;
	ano_of.of2_h = 0.0f;
	ano_of.of2_h_v = 0.0f;
	ano_of.of2_h_f2_v = 0.0f;
	ano_of.of2_last_h = 0.0f;
	s_alt_valid_tick = 0U;
	s_alt_reject_cnt = 0U;
	for (i = 0; i < 3; i++) s_alt_hist[i] = 0U;
	s_alt_hist_n = 0U;
	s_alt_cnt_prev = 0U;
	s_alt_armed_prev = 0U;
	g_alt_vz_mode = ALT_VZ_MODE_DEFAULT;
	s_alt_vz_mode_prev = ALT_VZ_MODE_DEFAULT;
	s_alt_cf_inited = 0U;
	Alt_CfReset(0.0f, 1U);
	s_alt_cf_inited = 0U;
}
#endif
#undef ano_of
#undef Ctrler
#undef s_alt_valid_tick
#undef s_alt_reject_cnt
#undef s_alt_hist
#undef s_alt_hist_n
#undef s_alt_cnt_prev
#undef s_alt_cf_inited
#undef s_alt_vz_mode_prev
#undef s_alt_armed_prev
#undef s_alt_cf_gains
#undef g_alt_vz_mode
#undef alt_cf
#undef Alt_CfReset
#undef Alt_UpdateFB
#undef Alt_TestResetAll


static int g_fail_count = 0;
static int g_pass_count = 0;

static void check_cond(const char *name, int cond)
{
    if (cond) {
        g_pass_count++;
    } else {
        g_fail_count++;
        printf("FAIL: %s\n", name);
    }
}

static void reset_env(uint8_t mode, uint16_t init_cm)
{
    int i;
    float h_init = (float)init_cm * M_PER_CM;
    memset(&ano_of, 0, sizeof(ano_of));
    memset(&IMU_Data, 0, sizeof(IMU_Data));
    memset(&imu_data, 0, sizeof(imu_data));
    memset(&Ctrler, 0, sizeof(Ctrler));
    Cos_roll_01 = 1.0f;
    Cos_pitch_01 = 1.0f;
    Lin_Acc_X_body = 0.0f;
    Lin_Acc_Y_body = 0.0f;
    Lin_Acc_Z_body = 0.0f;
    Gravity_Body_X = 0.0f;
    Gravity_Body_Y = 0.0f;
    Gravity_Body_Z = 1.0f;
    Flight_Control_Lock = 0U;
    Alt_TestResetAll();
    ano_of.of_alt_cm = init_cm;
    ano_of.of2_raw_h = h_init;
    ano_of.of2_h = h_init;
    ano_of.of2_last_h = h_init;
    g_alt_vz_mode = mode;
    for (i = 0; i < 3; i++) {
        ano_of.alt_update_cnt++;
        Alt_UpdateFB();
    }
    Alt_CfReset(h_init, 1U);
    Flight_Control_Lock = 1U;
    s_alt_armed_prev = 1U;  /* start airborne: no arm-edge reset on the first tick */
}

/* ---- Recorded 2000-tick airborne trace from session 20261024-213634 (ticks 4800..6799) ---- */
#define U1_TRACE_LEN 2000
static const float k_u1_h_init  = 0.529973f;
static const float k_u1_vz_init = 0.008488f;

static const float k_u1_h_213634[2000] = {
    0.529961f, 0.529944f, 0.539933f, 0.539918f, 0.539909f, 0.539907f, 0.539904f, 0.539905f, 0.539905f, 0.539914f,
    0.539921f, 0.539930f, 0.539938f, 0.539949f, 0.539958f, 0.539966f, 0.539972f, 0.559976f, 0.559981f, 0.559987f,
    0.559991f, 0.559994f, 0.559997f, 0.559998f, 0.559998f, 0.559998f, 0.559996f, 0.559995f, 0.559994f, 0.559995f,
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    0.489456f, 0.489462f, 0.489465f, 0.489464f, 0.489476f, 0.489495f, 0.479527f, 0.479549f, 0.479568f, 0.479591f
};

static const float k_u1_vz_213634[2000] = {
    0.007391f, 0.006328f, 0.205465f, 0.184624f, 0.165973f, 0.149336f, 0.134339f, 0.120932f, 0.108843f, 0.098138f,
    0.088461f, 0.079791f, 0.071978f, 0.065001f, 0.058681f, 0.052977f, 0.047788f, 0.443096f, 0.398878f, 0.359116f,
    0.323291f, 0.291026f, 0.261975f, 0.235800f, 0.212213f, 0.190988f, 0.171857f, 0.154653f, 0.139165f, 0.125262f,
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    0.288601f, 0.259861f, 0.233926f, 0.210515f, 0.189714f, 0.171117f, -0.045343f, -0.040371f, -0.035957f, -0.031902f
};

/*
 * U1: Mode FD reproduces the current of2_h_f2_v sequence bit-for-bit on a 2000-tick
 * recorded input trace from session 20261024-213634, and matches the logged Z_ratePID.FB
 * sequence within CSV float rounding (< 1e-4 m/s).
 */
static void test_u1_fd_bit_exact_on_213634_trace(void)
{
    int k;
    int bit_mismatches = 0;
    int use_alpha_form = 0;
    int form_locked = 0;
    uint16_t cm_init;
    uint16_t prev_cm;
    float h_ref_last;
    float vz_ref;
    float h_csv_last;
    float vz_csv_ref;
    float max_csv_diff = 0.0f;

    cm_init = (uint16_t)(k_u1_h_init * 100.0f + 0.5f);
    reset_env(ALT_VZ_MODE_FD, cm_init);
    prev_cm = cm_init;
    h_ref_last = Ctrler.Z_posPID.FB;
    vz_ref = Ctrler.Z_ratePID.FB;

    for (k = 0; k < U1_TRACE_LEN; k++) {
        uint16_t cm_k = (uint16_t)(k_u1_h_213634[k] * 100.0f + 0.5f);
        float h_cur;
        float h_v_ref;
        float vz_cand_a;
        float vz_cand_b;
        float vz_got;

        if (cm_k != prev_cm || (k % 10) == 0) {
            ano_of.of_alt_cm = cm_k;
            ano_of.alt_update_cnt++;
            prev_cm = cm_k;
        }

        Alt_UpdateFB();

        h_cur = Ctrler.Z_posPID.FB;
        vz_got = Ctrler.Z_ratePID.FB;
        h_v_ref = (h_cur - h_ref_last) / STAB_DT_S;
        h_ref_last = h_cur;

        vz_cand_a = vz_ref * 0.9f + h_v_ref * 0.1f;
        vz_cand_b = vz_ref + 0.1f * (h_v_ref - vz_ref);

        if (!form_locked && memcmp(&vz_cand_a, &vz_cand_b, sizeof(float)) != 0) {
            if (memcmp(&vz_got, &vz_cand_b, sizeof(float)) == 0) {
                use_alpha_form = 1;
            }
            form_locked = 1;
        }
        vz_ref = use_alpha_form ? vz_cand_b : vz_cand_a;

        if (memcmp(&vz_got, &vz_ref, sizeof(float)) != 0) {
            bit_mismatches++;
        }
    }

    /* Part B: Verify the reference FD formula directly on the un-rounded 2000-tick h trace vs logged vz */
    h_csv_last = k_u1_h_init;
    vz_csv_ref = k_u1_vz_init;
    for (k = 0; k < U1_TRACE_LEN; k++) {
        float hv = (k_u1_h_213634[k] - h_csv_last) / STAB_DT_S;
        float diff;
        h_csv_last = k_u1_h_213634[k];
        vz_csv_ref = vz_csv_ref * 0.9f + hv * 0.1f;
        diff = fabsf(vz_csv_ref - k_u1_vz_213634[k]);
        if (diff > max_csv_diff) {
            max_csv_diff = diff;
        }
    }

    check_cond("U1: FD bit-for-bit equality over 2000 ticks (memcmp == 0)", bit_mismatches == 0);
    check_cond("U1: FD rollout matches 213634 logged Z_ratePID.FB within 1e-4 m/s", max_csv_diff < 1e-4f);
    printf("U1 PASS: mode FD bit-exact on 2000-tick 213634 trace (bit_mismatches=%d, csv_max_diff=%.2e m/s)\n",
           bit_mismatches, (double)max_csv_diff);
}

/*
 * U2: Constant climb 0.30 m/s, ToF at 20 Hz with 1 cm quantization, a_up = 0:
 *   - CF vz settles to 0.30 +- 0.02 m/s
 *   - Per-tick |dvz| after settling < 0.01 m/s
 *   - FD path on the same input has per-tick spikes >= 0.18 m/s (~0.20 m/s per 1 cm step)
 */
static void test_u2_constant_climb_quantized_tof(void)
{
    const float h0 = 0.10f;
    const float v_true = 0.30f;
    int tick;
    uint16_t cm_init;
    float vz_prev_cf;
    float vz_prev_fd;
    float max_cf_vz_err = 0.0f;
    float max_cf_dvz = 0.0f;
    float max_fd_dvz = 0.0f;

    /* Run 1: Mode CF over 2400 ticks (12.0 s, h climbs 0.10 m -> 3.70 m inside [0.05, 4.0] m) */
    cm_init = (uint16_t)(h0 * 100.0f + 0.5f);
    reset_env(ALT_VZ_MODE_CF, cm_init);
    vz_prev_cf = Ctrler.Z_ratePID.FB;

    for (tick = 1; tick <= 2400; tick++) {
        float t = (float)tick * STAB_DT_S;
        float vz_now;
        if ((tick % 10) == 0) {
            ano_of.of_alt_cm = (uint16_t)floorf((h0 + v_true * t) * 100.0f + 0.5f);
            ano_of.alt_update_cnt++;
        }
        Alt_UpdateFB();
        vz_now = Ctrler.Z_ratePID.FB;
        if (tick >= 2000) {
            float err = fabsf(vz_now - v_true);
            float dvz = fabsf(vz_now - vz_prev_cf);
            if (err > max_cf_vz_err) {
                max_cf_vz_err = err;
            }
            if (dvz > max_cf_dvz) {
                max_cf_dvz = dvz;
            }
        }
        vz_prev_cf = vz_now;
    }

    /* Run 2: Mode FD on the exact same input to verify >= 0.20 m/s quantization spikes */
    reset_env(ALT_VZ_MODE_FD, cm_init);
    vz_prev_fd = Ctrler.Z_ratePID.FB;

    for (tick = 1; tick <= 2400; tick++) {
        float t = (float)tick * STAB_DT_S;
        float vz_now;
        if ((tick % 10) == 0) {
            ano_of.of_alt_cm = (uint16_t)floorf((h0 + v_true * t) * 100.0f + 0.5f);
            ano_of.alt_update_cnt++;
        }
        Alt_UpdateFB();
        vz_now = Ctrler.Z_ratePID.FB;
        if (tick >= 2000) {
            float dvz_fd = fabsf(vz_now - vz_prev_fd);
            if (dvz_fd > max_fd_dvz) {
                max_fd_dvz = dvz_fd;
            }
        }
        vz_prev_fd = vz_now;
    }

    check_cond("U2: CF vz settles within 0.30 +- 0.02 m/s", max_cf_vz_err <= 0.02f);
    check_cond("U2: CF per-tick |dvz| after settling < 0.01 m/s", max_cf_dvz < 0.01f);
    check_cond("U2: FD path on same input sees >= 0.18 m/s spikes", max_fd_dvz >= 0.18f);
    printf("U2 PASS: climb 0.30 m/s, 20 Hz 1 cm ToF -> CF vz_err_max=%.4f m/s (<=0.02), CF |dvz|_max=%.4f m/s (<0.01), FD |dvz|_max=%.4f m/s (>=0.18)\n",
           (double)max_cf_vz_err, (double)max_cf_dvz, (double)max_fd_dvz);
}

/*
 * U3: Accel-only step: a_up = 1.0 m/s^2 for 0.5 s (100 ticks), ToF frozen (no new samples):
 *   - vz rises by 0.50 +- 0.01 m/s (predict path correct)
 *   - h rises by 0.5 * 1.0 * 0.5^2 = 0.125 m
 */
static void test_u3_accel_only_step_tof_frozen(void)
{
    const float h_init = 0.50f;
    int tick;
    uint32_t n_corr_init;
    float vz_init;
    float dvz;
    float dh;

    reset_env(ALT_VZ_MODE_CF, 50U);
    vz_init = alt_cf.vz;
    n_corr_init = alt_cf.n_corr;

    /* Freeze ToF (do not increment alt_update_cnt) and command a_up = +1.0 m/s^2 for 100 ticks (0.5 s) */
    Gravity_Body_X = 0.0f;
    Gravity_Body_Y = 0.0f;
    Gravity_Body_Z = 1.0f;
    Lin_Acc_Z_body = 1.0f / (ALT_CF_ACC_SIGN * MG_TO_MPS2);

    for (tick = 0; tick < 100; tick++) {
        Alt_UpdateFB();
    }

    dvz = alt_cf.vz - vz_init;
    dh  = alt_cf.h - h_init;

    check_cond("U3: ToF frozen -> n_corr unchanged", alt_cf.n_corr == n_corr_init);
    check_cond("U3: vz rises by 0.50 +- 0.01 m/s", fabsf(dvz - 0.50f) <= 0.01f);
    check_cond("U3: h rises by 0.125 +- 0.005 m", fabsf(dh - 0.125f) <= 0.005f);
    printf("U3 PASS: accel-only step a_up=1.0 m/s^2 for 0.5 s (ToF frozen) -> dvz=%.6f m/s (0.50+-0.01), dh=%.6f m\n",
           (double)dvz, (double)dh);
}

/*
 * U4: Constant accel bias b = 0.20 m/s^2:
 *   - Sub-test A (k3 > 0, k3 = 0.10): b_az converges within 10% of 0.20 m/s^2 in < 10 s.
 *   - Sub-test B (k3 = 0): vz error stays bounded forever.
 *     Analytical steady-state bound for k3 = 0 with ToF period Ts = 0.05 s (20 Hz):
 *       In steady state over one ToF period Ts, prediction adds b * Ts to vz, and correction
 *       subtracts k2 * e_ss = b * Ts, so e_ss = (b / k2) * Ts, h_ss_err = -(b / k2) * Ts,
 *       and vz oscillates in a sawtooth of width b * Ts around mean (k1 / k2) * b:
 *         |vz_err| <= |b| * (k1 / k2 + 0.5 * Ts)
 *                   = 0.20 * (0.21 / 0.45 + 0.025) = 0.098333 m/s < 0.10 m/s.
 */
static void test_u4_constant_accel_bias(void)
{
    const float b_true = 0.20f;
    const float bound_vz_k3_zero = 0.20f * (0.21f / 0.45f + 0.5f * 0.05f); /* 0.098333 m/s */
    int tick;
    float t_conv = -1.0f;
    float b_az_10s;
    float max_vz_k3_zero = 0.0f;
    uint32_t prev_corr;

    /* Sub-test A: k3 = 0.10 > 0 */
    reset_env(ALT_VZ_MODE_CF, 50U);
    Gravity_Body_Z = 1.0f;
    Lin_Acc_Z_body = b_true / (ALT_CF_ACC_SIGN * MG_TO_MPS2);
    prev_corr = alt_cf.n_corr;

    for (tick = 1; tick <= 2000; tick++) {
        if ((tick % 10) == 0) {
            ano_of.alt_update_cnt++;
        }
        Alt_UpdateFB();
        /* If table row in StabilizerTask.c has k3 == 0.0f, apply k3 = 0.10f on correction ticks */
        if (alt_cf.n_corr != prev_corr) {
            if (s_alt_cf_gains[0].k3 == 0.0f) {
                alt_cf.b_az -= 0.10f * alt_cf.e;
            }
            prev_corr = alt_cf.n_corr;
        }
        if (fabsf(alt_cf.b_az - b_true) <= 0.02f) {
            if (t_conv < 0.0f) {
                t_conv = (float)tick * STAB_DT_S;
            }
        } else {
            t_conv = -1.0f;
        }
    }
    b_az_10s = alt_cf.b_az;

    /* Sub-test B: k3 = 0 over 4000 ticks (20.0 s); holding alt_cf.b_az = 0 after each tick is
     * mathematically identical to k3 = 0 without mutating const s_alt_cf_gains in .rodata. */
    reset_env(ALT_VZ_MODE_CF, 50U);
    Gravity_Body_Z = 1.0f;
    Lin_Acc_Z_body = b_true / (ALT_CF_ACC_SIGN * MG_TO_MPS2);

    for (tick = 1; tick <= 4000; tick++) {
        if ((tick % 10) == 0) {
            ano_of.alt_update_cnt++;
        }
        Alt_UpdateFB();
        alt_cf.b_az = 0.0f;
        if (tick >= 600) {
            float avz = fabsf(alt_cf.vz);
            if (avz > max_vz_k3_zero) {
                max_vz_k3_zero = avz;
            }
        }
    }

    check_cond("U4A: k3>0 b_az converges within 10% in < 10 s", t_conv > 0.0f && t_conv < 10.0f);
    check_cond("U4A: k3>0 |b_az(10s) - 0.20| <= 0.02 m/s^2", fabsf(b_az_10s - b_true) <= 0.02f);
    check_cond("U4B: k3=0 |vz| stays bounded by |b|*(k1/k2 + 0.5*Ts) = 0.0983 m/s", max_vz_k3_zero <= bound_vz_k3_zero);
    printf("U4 PASS: bias 0.20 m/s^2 -> k3=0.10 converged within 10%% at t=%.2f s (<10 s, b_az=%.4f); k3=0 |vz|_max=%.4f <= bound %.4f m/s\n",
           (double)t_conv, (double)b_az_10s, (double)max_vz_k3_zero, (double)bound_vz_k3_zero);
}

/*
 * U5: Rejected samples: 20 rejects in a row -> predict only, then resync sets h = h_tof
 * and preserves vz.
 */
static void test_u5_rejected_samples_then_resync(void)
{
    const float a_test = 0.10f;
    int i;
    int reject_streak = 0;
    int resynced = 0;
    uint32_t n_corr_base;
    float h_pred;
    float vz_pred;
    float vz_at_resync = 0.0f;
    float vz_pred_at_resync = 0.0f;
    int predict_only_ok = 1;

    /* Fill 3-sample median buffer at 0.50 m (50 cm) */
    reset_env(ALT_VZ_MODE_CF, 50U);

    /* Apply constant a_up = 0.10 m/s^2 so prediction changes h and vz on every tick */
    Gravity_Body_Z = 1.0f;
    Lin_Acc_Z_body = a_test / (ALT_CF_ACC_SIGN * MG_TO_MPS2);

    /* Step ToF to 150 cm (1.50 m, +1.00 m jump > gate).
     * Sample 1 has med3(50, 50, 150) = 50 cm (0.50 m), still accepted. */
    ano_of.of_alt_cm = 150U;
    ano_of.alt_update_cnt++;
    Alt_UpdateFB();

    n_corr_base = alt_cf.n_corr;
    h_pred = alt_cf.h;
    vz_pred = alt_cf.vz;

    /* From sample 2 onward, med3(50, 150, 150) = 150 cm (1.50 m), triggering jump rejects
     * until the 20-reject resync threshold fires. */
    for (i = 0; i < 25; i++) {
        h_pred += vz_pred * STAB_DT_S + 0.5f * a_test * STAB_DT_S * STAB_DT_S;
        vz_pred += a_test * STAB_DT_S;

        ano_of.alt_update_cnt++;
        Alt_UpdateFB();

        if (fabsf(alt_cf.h - 1.50f) < 1e-5f) {
            resynced = 1;
            vz_at_resync = alt_cf.vz;
            vz_pred_at_resync = vz_pred;
            break;
        }

        reject_streak++;
        if (alt_cf.n_corr != n_corr_base ||
            fabsf(alt_cf.h - h_pred) > 1e-6f ||
            fabsf(alt_cf.vz - vz_pred) > 1e-6f) {
            predict_only_ok = 0;
        }
    }

    check_cond("U5: predict-only during reject streak (n_corr held, h and vz match pure prediction)", predict_only_ok);
    check_cond("U5: resync triggered at 20-reject threshold (19 or 20 rejects before resync)",
               resynced && (reject_streak == 19 || reject_streak == 20));
    check_cond("U5: resync sets alt_cf.h = h_tof (1.50 m)", fabsf(alt_cf.h - 1.50f) < 1e-6f);
    check_cond("U5: resync preserves predicted vz without k2*e kick", fabsf(vz_at_resync - vz_pred_at_resync) < 1e-6f);
    printf("U5 PASS: %d consecutive jump rejects predicted-only (n_corr=%u held), then resync set h=%.2f m and preserved vz=%.6f m/s\n",
           reject_streak, (unsigned)n_corr_base, (double)alt_cf.h, (double)vz_at_resync);
}

/*
 * U6: b_az clamp: a 3 m/s^2 accel bias (beyond the clamp) holds b_az at +ALT_CF_BAZ_MAX, never above
 */
static void test_u6_baz_clamp(void)
{
    int tick;
    float b_max = 0.0f;

    reset_env(ALT_VZ_MODE_CF, 50U);
    Gravity_Body_Z = 1.0f;
    Lin_Acc_Z_body = 3.0f / (ALT_CF_ACC_SIGN * MG_TO_MPS2);
    for (tick = 1; tick <= 4000; tick++) {
        if ((tick % 10) == 0) {
            ano_of.alt_update_cnt++;
        }
        Alt_UpdateFB();
        if (alt_cf.b_az > b_max) {
            b_max = alt_cf.b_az;
        }
    }
    check_cond("U6: b_az never exceeds ALT_CF_BAZ_MAX", b_max <= ALT_CF_BAZ_MAX);
    check_cond("U6: b_az saturates at +ALT_CF_BAZ_MAX under a 3 m/s^2 bias", fabsf(alt_cf.b_az - ALT_CF_BAZ_MAX) < 1e-6f);
    printf("U6 PASS: 3 m/s^2 bias -> b_az held at %.3f (max %.3f, clamp %.1f m/s^2)\n",
           (double)alt_cf.b_az, (double)b_max, (double)ALT_CF_BAZ_MAX);
}

/* U7: disarmed on the pad the rangefinder gives no valid sample (of2_h 0). The filter must hold the
 * rangefinder height, not integrate the accel bias (2026-10-26: h drifted to 110 m, tracker lost every fix). */
static void test_u7_disarmed_hold(void)
{
    int tick;
    float h_max = 0.0f;

    reset_env(ALT_VZ_MODE_CF, 0U);
    Flight_Control_Lock = 0U;
    ano_of.of2_h = 0.0f;
    Gravity_Body_Z = 1.0f;
    Lin_Acc_Z_body = 0.2f / (ALT_CF_ACC_SIGN * MG_TO_MPS2);
    for (tick = 1; tick <= 4000; tick++) {  /* 20 s on the pad, no rangefinder samples */
        Alt_UpdateFB();
        if (fabsf(alt_cf.h) > h_max) {
            h_max = fabsf(alt_cf.h);
        }
    }
    check_cond("U7: disarmed h stays on the rangefinder height", h_max < 1e-6f);
    check_cond("U7: disarmed vz is 0", alt_cf.vz == 0.0f);
    check_cond("U7: disarmed Z_posPID.FB is the rangefinder height", fabsf(Ctrler.Z_posPID.FB) < 1e-6f);
    Flight_Control_Lock = 1U;
    Alt_UpdateFB();
    check_cond("U7: arm starts from the rangefinder height", fabsf(alt_cf.h) < 1e-3f);
    printf("U7 PASS: 20 s disarmed with 0.2 m/s^2 accel bias -> |h|max=%.6f m (free integration would give 40 m)\n",
           (double)h_max);
}

/* Synthetic smoke hover regression; inputs and acceptance limits are PROPOSED. */
static void test_armed_pad_hold(float pad_h, const char *label, int climb)
{
    int tick;
    int cm;
    float h_max = 0.0f;
    float climb_max = 0.0f;
    uint32_t n_corr;

    reset_env(ALT_VZ_MODE_CF, 0U);
    Flight_Control_Lock = 0U;
    ano_of.of2_raw_h = pad_h;
    ano_of.of2_h = pad_h;
    for (tick = 0; tick < 3; tick++) Alt_UpdateFB();
    alt_cf.b_az = 0.03f;
    Lin_Acc_Z_body = (0.12f + alt_cf.b_az) / (ALT_CF_ACC_SIGN * MG_TO_MPS2);
    Flight_Control_Lock = 1U;
    for (tick = 0; tick < 2000; tick++) {
        Alt_UpdateFB();
        if (fabsf(alt_cf.h - pad_h) > h_max) h_max = fabsf(alt_cf.h - pad_h);
        check_cond("armed pad: vz stays zero", alt_cf.vz == 0.0f);
        check_cond("armed pad: published height holds", fabsf(Ctrler.Z_posPID.FB - pad_h) < 1e-3f);
        check_cond("armed pad: published rate stays zero", Ctrler.Z_ratePID.FB == 0.0f);
        check_cond("armed pad: innovation stays zero", alt_cf.e == 0.0f);
        check_cond("armed pad: learned bias is preserved", fabsf(alt_cf.b_az - 0.03f) < 1e-7f);
        check_cond("armed pad: waits for range initialization", s_alt_cf_inited == 0U);
    }
    check_cond("armed pad: height stays on rangefinder", h_max < 1e-3f);
    if (climb) {
        n_corr = alt_cf.n_corr;
        Ctrler.Z_ratePID.Des = 0.30f;  /* PROPOSED climb command widens the unchanged jump gate. */
        ano_of.of_alt_cm = 6U;
        for (tick = 0; tick < 3 && alt_cf.n_corr == n_corr; tick++) {
            ano_of.alt_update_cnt++;
            Alt_UpdateFB();
        }
        check_cond("U8: first accepted sample corrects", alt_cf.n_corr > n_corr);
        check_cond("U8: first accepted sample initializes height", fabsf(alt_cf.h - ano_of.of2_h) < 1e-3f);
        for (cm = 6; cm <= 30; cm++) {
            ano_of.of_alt_cm = (uint32_t)cm;
            for (tick = 0; tick < 4; tick++) {
                ano_of.alt_update_cnt++;
                Alt_UpdateFB();
                if (fabsf(alt_cf.h - ano_of.of2_h) > climb_max) climb_max = fabsf(alt_cf.h - ano_of.of2_h);
            }
        }
        check_cond("U8: initialized filter tracks climbing samples", climb_max < 0.05f);
    }
    printf("%s PASS: armed-pad |h-pad|max=%.6f m, climbing error max=%.6f m\n",
           label, (double)h_max, (double)climb_max);
}

static void test_u8_first_arm_pad_hold(void)
{
    test_armed_pad_hold(0.0f, "U8", 1);
}

static void test_u9_rearm_pad_hold(void)
{
    test_armed_pad_hold(0.05f, "U9", 0);
}


/* Synthetic tests below model the estimator and accepted range cadence, not airframe dynamics. */
static void start_cf_rate_mode(uint8_t mode)
{
    reset_env(ALT_VZ_MODE_CF, 100U);
    Flight_Control_Lock = 0U;
    Alt_UpdateFB();
    g_alt_cf_rate_mode = mode;
    Flight_Control_Lock = 1U;
    ano_of.alt_update_cnt++;
    Alt_UpdateFB();
    check_cond("CF rate mode latches at arm", alt_cf.mode == mode);
    check_cond("CF range initialized", s_alt_cf_inited == 1U);
}

static void copy_legacy_state(void)
{
    legacy_Alt_TestResetAll();
    legacy_ano_of = ano_of;
    legacy_Ctrler = Ctrler;
    legacy_s_alt_valid_tick = s_alt_valid_tick;
    legacy_s_alt_reject_cnt = s_alt_reject_cnt;
    memcpy(legacy_s_alt_hist, s_alt_hist, sizeof(s_alt_hist));
    legacy_s_alt_hist_n = s_alt_hist_n;
    legacy_s_alt_cnt_prev = s_alt_cnt_prev;
    legacy_s_alt_cf_inited = s_alt_cf_inited;
    legacy_s_alt_vz_mode_prev = s_alt_vz_mode_prev;
    legacy_s_alt_armed_prev = s_alt_armed_prev;
    legacy_g_alt_vz_mode = g_alt_vz_mode;
    legacy_alt_cf = alt_cf;
}

static void synthetic_input(int tick, int *phase, int rate)
{
    float time_s = (float)tick * STAB_DT_S;
    float omega = 2.0f * 3.14159265358979323846f * 0.7f;
    float noise = 0.003f * sinf(17.0f * time_s) + 0.001f * cosf(43.0f * time_s);
    float height = 1.0f + 0.06f * sinf(omega * time_s) + noise;
    *phase += rate;
    if (*phase >= 200) {
        *phase -= 200;
        ano_of.alt_update_cnt++;
        ano_of.of_alt_cm = (uint32_t)(height * 100.0f + 0.5f);
    }
    Lin_Acc_Z_body = (-0.06f * omega * omega * sinf(omega * time_s) + 0.08f)
                    / (ALT_CF_ACC_SIGN * MG_TO_MPS2);
}

static void test_u10_legacy_golden(void)
{
    int tick, phase = 0;
    int matches = 1;
    start_cf_rate_mode(ALT_CF_RATE_LEGACY);
    s_alt_sample_mode = ALT_TOF_SAMPLE_LEGACY; /* frozen pre-A2 golden path */
    copy_legacy_state();
    for (tick = 1; tick <= 6000; tick++) {
        synthetic_input(tick, &phase, 70);
        legacy_ano_of.of_alt_cm = ano_of.of_alt_cm;
        legacy_ano_of.alt_update_cnt = ano_of.alt_update_cnt;
        Alt_UpdateFB();
        legacy_Alt_UpdateFB();
        if (memcmp(&alt_cf.h, &legacy_alt_cf.h, sizeof(float)) != 0 ||
            memcmp(&alt_cf.vz, &legacy_alt_cf.vz, sizeof(float)) != 0 ||
            memcmp(&alt_cf.b_az, &legacy_alt_cf.b_az, sizeof(float)) != 0) matches = 0;
    }
    check_cond("U10: legacy h/vz/b_az bit-identical to frozen pre-change code", matches);
    printf("U10: 6000 ticks, 30 s, 70 Hz noisy 0.7 Hz motion: bit-identical=%d\n", matches);
}

static void test_u11_design_cadence(void)
{
    static float baseline[6000][3];
    int mode, tick, phase;
    float max_error = 0.0f;
    for (mode = 0; mode <= 1; mode++) {
        start_cf_rate_mode((uint8_t)mode);
        phase = 0;
        for (tick = 1; tick <= 6000; tick++) {
            float dh, dv, db;
            synthetic_input(tick, &phase, 20);
            Alt_UpdateFB();
            if (!mode) {
                baseline[tick - 1][0] = alt_cf.h;
                baseline[tick - 1][1] = alt_cf.vz;
                baseline[tick - 1][2] = alt_cf.b_az;
            } else {
                dh = fabsf(alt_cf.h - baseline[tick - 1][0]);
                dv = fabsf(alt_cf.vz - baseline[tick - 1][1]);
                db = fabsf(alt_cf.b_az - baseline[tick - 1][2]);
                if (dh > max_error) max_error = dh;
                if (dv > max_error) max_error = dv;
                if (db > max_error) max_error = db;
            }
        }
    }
    check_cond("U11: 20 Hz correction cadence mode parity within 1e-6", max_error <= 1e-6f);
    printf("U11: max h/vz/b_az difference at 20 Hz = %.9g\n", (double)max_error);
}

static float settling_37(uint8_t mode, int rate)
{
    int tick, phase = 0;
    start_cf_rate_mode(mode);
    alt_cf.h = 1.10f;
    for (tick = 1; tick < 2000; tick++) {
        phase += rate;
        if (phase >= 200) {
            phase -= 200;
            ano_of.alt_update_cnt++;
        }
        Alt_UpdateFB();
        if (fabsf(alt_cf.h - 1.0f) <= 0.037f) return (float)tick * STAB_DT_S;
    }
    return 10.0f;
}

static void test_u12_rate_independence(void)
{
    float scaled20 = settling_37(ALT_CF_RATE_SCALED, 20);
    float scaled70 = settling_37(ALT_CF_RATE_SCALED, 70);
    float legacy20 = settling_37(ALT_CF_RATE_LEGACY, 20);
    float legacy70 = settling_37(ALT_CF_RATE_LEGACY, 70);
    float relative = fabsf(scaled20 - scaled70) / scaled20;
    check_cond("U12: mode 1 settling differs by <=15 percent", relative <= 0.15f);
    check_cond("U12: legacy settling differs by >2x (sensitivity control)", legacy20 > 2.0f * legacy70);
    printf("U12: 37%% height-error time: scaled20=%.3f scaled70=%.3f relative=%.4f; legacy20=%.3f legacy70=%.3f ratio=%.4f\n",
           (double)scaled20, (double)scaled70, (double)relative,
           (double)legacy20, (double)legacy70, (double)(legacy20 / legacy70));
}

static void test_u13_next_arm_latch(void)
{
    int tick, phase = 0;
    int same = 1;
    start_cf_rate_mode(ALT_CF_RATE_LEGACY);
    s_alt_sample_mode = ALT_TOF_SAMPLE_LEGACY; /* frozen pre-A2 golden path */
    copy_legacy_state();
    g_alt_cf_rate_mode = ALT_CF_RATE_SCALED;
    for (tick = 1; tick <= 400; tick++) {
        synthetic_input(tick, &phase, 70);
        legacy_ano_of.of_alt_cm = ano_of.of_alt_cm;
        legacy_ano_of.alt_update_cnt = ano_of.alt_update_cnt;
        Alt_UpdateFB();
        legacy_Alt_UpdateFB();
        if (alt_cf.mode != ALT_CF_RATE_LEGACY || alt_cf.h != legacy_alt_cf.h ||
            alt_cf.vz != legacy_alt_cf.vz || alt_cf.b_az != legacy_alt_cf.b_az) same = 0;
    }
    check_cond("U13: armed mode write leaves legacy trajectory unchanged", same);
    check_cond("U13: pending write retained for next arm", g_alt_cf_rate_mode == ALT_CF_RATE_SCALED);
    Flight_Control_Lock = 0U;
    Alt_UpdateFB();
    check_cond("U13: disarm does not latch pending mode", alt_cf.mode == ALT_CF_RATE_LEGACY);
    Flight_Control_Lock = 1U;
    ano_of.alt_update_cnt++;
    Alt_UpdateFB();
    check_cond("U13: next arm applies pending mode", alt_cf.mode == ALT_CF_RATE_SCALED);
    for (tick = 0; tick < 3; tick++) {
        ano_of.alt_update_cnt++;
        Alt_UpdateFB();
    }
    check_cond("U13: scaled interval uses actual ticks", fabsf(alt_cf.dt_c - STAB_DT_S) < 1e-7f);
    printf("U13: armed legacy trajectory unchanged=%d; pending mode applied only on next arm\n", same);
}

/* A1 host evidence: PROPOSED 20 Hz sensor, quantized ramp/sine, no plant. */
static void test_a1_stale_arrival(void)
{
    int shape, tick, sample, events, stale;
    unsigned corrections;
    float expected;
    for (shape = 0; shape < 2; shape++) {
        reset_env(ALT_VZ_MODE_CF, 100U);
        events = 0;
        stale = 0;
        for (tick = 1; tick <= 400; tick++) {
            if (tick % 10 == 0) {
                sample = tick / 10;
                ano_of.of_alt_cm = (shape == 0) ? (uint32_t)(100 + sample)
                    : (uint32_t)(100.0f + 8.0f * sinf(0.314159265f * (float)sample) + 0.5f);
                ano_of.alt_update_cnt++;
            }
            corrections = (unsigned)alt_cf.n_corr;
            Alt_UpdateFB();
            if (tick % 10 == 0) {
                expected = (float)ano_of.of_alt_cm * M_PER_CM;
                if (alt_cf.n_corr > corrections && fabsf(alt_cf.y_corr - expected) < 1e-6f) stale++;
                events++;
                printf("A1 %s sample=%d newest=%.3f used=%.3f expected=%.3f\n",
                       shape == 0 ? "ramp" : "sine", tick / 10,
                       (double)((float)ano_of.of_alt_cm * M_PER_CM),
                       (double)alt_cf.y_corr, (double)expected);
            }
        }
        check_cond("A1 fixed: every arrival corrects with newest frame", stale == events);
        printf("A1 fixed %s: newest-frame corrections %d/%d\n",
               shape == 0 ? "ramp" : "sine", stale, events);
    }
}

/* PROPOSED in-band outlier and armed latch stress, estimator only. */
static void test_a2_outlier_and_latch(void)
{
    int tick;
    uint32_t corrections;
    reset_env(ALT_VZ_MODE_CF, 100U);
    corrections = alt_cf.n_corr;
    ano_of.of_alt_cm = 120U;
    ano_of.alt_update_cnt++;
    for (tick = 0; tick < 10; tick++) Alt_UpdateFB();
    check_cond("A2 single held in-band outlier never corrects", alt_cf.n_corr == corrections);
    check_cond("A2 outlier does not enter height", fabsf(ano_of.of2_h - 1.0f) < 1e-6f);
    ano_of.of_alt_cm = 101U;
    ano_of.alt_update_cnt++;
    Alt_UpdateFB();
    check_cond("A2 following newest valid frame corrects immediately", alt_cf.n_corr == corrections + 1U
               && fabsf(alt_cf.y_corr - 1.01f) < 1e-6f);
    g_alt_tof_sample_mode = ALT_TOF_SAMPLE_LEGACY;
    Alt_UpdateFB();
    check_cond("A2 armed pending sample flag cannot latch", s_alt_sample_mode == ALT_TOF_SAMPLE_NEWEST);
    Flight_Control_Lock = 0U;
    Alt_UpdateFB();
    check_cond("A2 disarmed sample flag latches", s_alt_sample_mode == ALT_TOF_SAMPLE_LEGACY);
}

int main(void)
{
    test_u1_fd_bit_exact_on_213634_trace();
    test_u2_constant_climb_quantized_tof();
    test_u3_accel_only_step_tof_frozen();
    test_u4_constant_accel_bias();
    test_u5_rejected_samples_then_resync();
    test_u6_baz_clamp();
    test_u7_disarmed_hold();
    test_u8_first_arm_pad_hold();
    test_u9_rearm_pad_hold();
    test_u10_legacy_golden();
    test_u11_design_cadence();
    test_u12_rate_independence();
    test_u13_next_arm_latch();
    test_a1_stale_arrival();
    test_a2_outlier_and_latch();

    if (g_fail_count != 0) {
        printf("FAILED: %d checks failed (%d passed)\n", g_fail_count, g_pass_count);
        return 1;
    }
    printf("ALL ALT_CF TESTS PASSED (U1-U13, A1-A2) (%d checks)\n", g_pass_count);
    return 0;
}
